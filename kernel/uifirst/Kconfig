## kernel/uifirst/Kconfig
```kconfig
# SPDX-License-Identifier: GPL-2.0-only
#
# UIFIRST UX scheduler and lock priority inheritance configuration
#

config UIFIRST
	bool "UIFIRST UX task scheduling and lock inheritance"
	default n
	help
	  Prioritize interactive UI, render, SurfaceFlinger, and audio tasks
	  across CFS runqueues, Binder IPC, futex waitqueues, mutexes, and
	  read/write semaphores.

config CAMERA_OPT
	bool "UIFIRST camera provider scheduling optimization"
	depends on UIFIRST
	default n
	help
	  Reduce runnable latency for camera HAL and provider worker threads.

config MMAP_LOCK_OPT
	bool "UIFIRST mmap_sem wakeup boost"
	depends on UIFIRST
	default n
	help
	  Boost wakeup placement for tasks woken on mm->mmap_sem contention.

config UIFIRST_AUDIO_OPT
	bool "UIFIRST short-running audio task scheduling assist"
	depends on UIFIRST
	select SCHEDSTATS
	default n
	help
	  Track runtime and sleep ratios for Android audio priority threads
	  (urgent audio / audio nice levels or target TGID) and fast-path
	  short-running audio bursts during wakeup preemption and entity pick.
```

## security/lockdown/Kconfig
```kconfig
# SPDX-License-Identifier: GPL-2.0
config SECURITY_LOCKDOWN_LSM
	bool "Basic module for enforcing kernel lockdown"
	depends on SECURITY
	default y
	help
	  Build support for an LSM that enforces a coarse kernel lockdown
	  behaviour.

choice
	prompt "Kernel default lockdown mode"
	default LOCK_DOWN_KERNEL_FORCE_NONE
	depends on SECURITY_LOCKDOWN_LSM
	help
	  The kernel can be configured to default to differing levels of
	  lockdown.

config LOCK_DOWN_KERNEL_FORCE_NONE
	bool "None"
	help
	  No lockdown functionality is enabled by default. Lockdown may be
	  enabled via the kernel commandline or /sys/kernel/security/lockdown.

config LOCK_DOWN_KERNEL_FORCE_INTEGRITY
	bool "Integrity"
	help
	  The kernel runs in integrity mode by default. Features that allow
	  the kernel to be modified at runtime are disabled.

config LOCK_DOWN_KERNEL_FORCE_CONFIDENTIALITY
	bool "Confidentiality"
	help
	  The kernel runs in confidentiality mode by default. Features that
	  allow the kernel to be modified at runtime or that permit userland
	  code to read confidential material held inside the kernel are
	  disabled.

endchoice
```
